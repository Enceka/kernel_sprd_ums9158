## drivers/media/platform/sprd/camera/Kconfig
```kconfig
# SPDX-License-Identifier: GPL-2.0-only
config VIDEO_SPRD_QOGIRN6L_CAMERA
	tristate "SPRD Qogirn6L camera"
	depends on ARCH_SPRD && I2C && PM
	help
	  Sensor, CSI, DCAM/ISP, camera power, DVFS and flash support for
	  the stock Qogirn6L camera HAL. Build as modules.
```

## drivers/media/platform/sprd/jpeg/Kconfig
```kconfig
config VIDEO_SPRD_QOGIRN6L_JPEG
	tristate "SPRD Qogirn6L JPEG codec"
	depends on ARCH_SPRD && PM && UNISOC_IOMMU
	help
	  Hardware JPEG encoding and decoding for the stock Qogirn6L camera HAL.
```

## drivers/unisoc_platform/sprd_fm/Kconfig
```kconfig
#
# Unisoc FM device configuration
#
menu "Unisoc FM Device Drivers"

config UNISOC_WCN_FM
	tristate "SPRD_FM"
	depends on UNISOC_WCN_BSP
	help
	  FM radio driver for the Unisoc WCN combo chip (marlin3 and
	  later), talking to the WCN core over the sprdwcn bus. Builds
	  sprd_fm.ko.

	  If you want to use the FM receiver on a 23xx-series Unisoc WCN
	  chip, say Y or M here.

endmenu
```

## drivers/vendor/common/touchscreen_v2/Kconfig
```kconfig
# SPDX-License-Identifier: GPL-2.0
#
# ZTE touchscreen framework, ported from
# android_kernel_zte_ums9620_mifi_u30air/drivers/vendor/common/touchscreen_v2.
#
# The original Kconfig sources ~25 per-chip drivers (goodix, chipone,
# focaltech, ...).  This tree carries only the shared core plus tlsc6x, which
# is the chip the E5 device tree actually describes:
#     tlsc6x@2e { compatible = "tlsc6x,tlsc6x_ts"; ... }

config TOUCHSCREEN_VENDOR_V2
	tristate "ZTE touchscreen framework (zte_tpd)"
	depends on I2C
	default n
	help
	  Shared core for the vendor touchscreen drivers: ztp_core,
	  ztp_report_algo, ztp_state_change and the optional under-fingerprint
	  (UFP) state machine.  Required by TOUCHSCREEN_TLSC6X_V3.

config TOUCHSCREEN_BOARD_NAME
	string "config board firmware folder"
	default "e5" if TOUCHSCREEN_TLSC6X_V3
	default ""
	help
	  Selects which tlsc6x_v3/firmware_config/<name>/ directory is put on
	  the include path.  That directory supplies tlsc6x_config.h (the
	  per-board feature macros) and comp_upd_bin.h (the bundled panel
	  firmware), so an empty or wrong value makes the include path point at
	  a directory that does not exist.

	  The four upstream ZTE values (chestnut, dates, pitaya, plum) are all
	  byte-identical to each other; "e5" is a copy with the proximity and
	  auto-firmware-upgrade macros turned off for this board.

config TOUCHSCREEN_UFP_MAC
	bool "tp under fingerprint status machine"
	default n

config TOUCHSCREEN_POINT_REPORT_CHECK
	bool "all point clean when tp irq timeout"
	default n

config TOUCHSCREEN_PSENSOR_REPORT_CHECK
	bool "tp promixity mode report near and far"
	default n

config TOUCHSCREEN_KNUCKLE
	bool "knuckle algo"
	default n

config TOUCHSCREEN_LCD_NOTIFY
	bool "lcd state notify"
	default n

source "drivers/vendor/common/touchscreen_v2/tlsc6x_v3/Kconfig"
```
